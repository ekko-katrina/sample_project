## main/Kconfig.projbuild
```kconfig
menu "TMY05 firmware settings"

    config TMY05_FW_VERSION_MAJOR
        int "Firmware major version"
        range 0 255
        default 1

    config TMY05_FW_VERSION_MINOR
        int "Firmware minor version"
        range 0 255
        default 0

    config TMY05_FW_VERSION_PATCH
        int "Firmware patch version"
        range 0 255
        default 4

    config TMY05_OTA_RELEASE_BASE_URL
        string "HTTPS immutable release-manifest base URL"
        default "https://app.temai.tech/ota-bin/releases"
        help
            Base URL for targeted A2 requests. The device appends
            /<modelId>/<major>.<minor>.<patch>.json.

    config TMY05_PROVISION_AP_PASSWORD
        string "Provisioning access point password"
        default "12345678"
        help
            WPA2 password for the TMY05-Setup-XXXX captive portal. It must have
            at least eight characters.

    config TMY05_MQTT_BROKER_URI
        string "Development MQTT broker URI"
        default "mqtt://8.138.244.51:1883"
        help
            MQTT broker used by the new-protocol profiles. The current default is
            the plaintext development broker and must not be used in production.

    config TMY05_MQTT_ALLOW_TEST_SN
        bool "Allow built-in test SN when NVS SN is absent"
        default y
        help
            Development-only fallback. Production builds should disable this
            option and provision mqtt_cfg/sn in NVS before MQTT starts.

endmenu
```

## sdkconfig.defaults
```kconfig
CONFIG_BOOTLOADER_APP_ROLLBACK_ENABLE=y
CONFIG_PARTITION_TABLE_CUSTOM=y
CONFIG_PARTITION_TABLE_CUSTOM_FILENAME="partitions-16MiB.csv"
CONFIG_TMY05_FW_VERSION_MAJOR=1
CONFIG_TMY05_FW_VERSION_MINOR=0
CONFIG_TMY05_FW_VERSION_PATCH=4
CONFIG_TMY05_OTA_RELEASE_BASE_URL="https://app.temai.tech/ota-bin/releases"
CONFIG_ESPTOOLPY_FLASHSIZE_16MB=y
CONFIG_MBEDTLS_CERTIFICATE_BUNDLE=y
CONFIG_BT_NIMBLE_ROLE_CENTRAL=y
CONFIG_BT_NIMBLE_ROLE_OBSERVER=y
CONFIG_BT_NIMBLE_ROLE_PERIPHERAL=y
CONFIG_BT_NIMBLE_ROLE_BROADCASTER=y
CONFIG_BT_NIMBLE_GATT_CLIENT=y
CONFIG_BT_NIMBLE_GATT_SERVER=y
CONFIG_BT_NIMBLE_MAX_CONNECTIONS=3
CONFIG_BT_NIMBLE_ATT_PREFERRED_MTU=512
```
